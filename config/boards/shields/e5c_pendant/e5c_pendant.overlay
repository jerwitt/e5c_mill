/*
 * Copyright (c) 2022 The ZMK Contributors
 *
 * SPDX-License-Identifier: MIT
 */

/ {
  chosen {
    zmk,kscan = &kscan0;
  };

  kscan0: kscan {
    compatible = "zmk,kscan-gpio-direct";

    label = "KSCAN";

    input-gpios
      = <&pro_micro 2 (GPIO_ACTIVE_LOW | GPIO_PULL_UP)> // Cycle Start (ALT-R)
      , <&pro_micro 0 (GPIO_ACTIVE_LOW | GPIO_PULL_UP)> // Feed Hold (SPACE)
      , <&pro_micro 1 (GPIO_ACTIVE_LOW | GPIO_PULL_UP)> // Stop (ESC)
      , <&pro_micro 3 (GPIO_ACTIVE_LOW | GPIO_PULL_UP)> // Fast Rapid Meta (SHIFT) 
      , <&pro_micro 4 (GPIO_ACTIVE_LOW | GPIO_PULL_UP)> // SingleStep Rapid Meta (CTRL)
      , <&pro_micro 5 (GPIO_ACTIVE_LOW | GPIO_PULL_UP)> // X-Axis Jog Left (Left Arrow)
      , <&pro_micro 8 (GPIO_ACTIVE_LOW | GPIO_PULL_UP)> // X-Axis Jog Right (Right Arrow)
      , <&pro_micro 6 (GPIO_ACTIVE_LOW | GPIO_PULL_UP)> // Y-Axis Jog Down (Down Arrow)
      , <&pro_micro 7 (GPIO_ACTIVE_LOW | GPIO_PULL_UP)> // Y-Axis Jog Up (Up Arrow)
      , <&pro_micro 20 (GPIO_ACTIVE_LOW | GPIO_PULL_UP)>// Z-Axis Jog Down (PgDn)
      , <&pro_micro 21 (GPIO_ACTIVE_LOW | GPIO_PULL_UP)>// Z-Axis Jog Up (PgUp)
      , <&pro_micro 10 (GPIO_ACTIVE_LOW | GPIO_PULL_UP)>// Coolant Toggle (ALT-F)
      ;

  };

};
