## config/boards/shields/e5c_pendant/Kconfig.defconfig
```kconfig
# Copyright (c) 2022 The ZMK Contributors
# SPDX-License-Identifier: MIT

config ZMK_BLE
  default y

config ZMK_USB
  default y


if SHIELD_E5C_PENDANT

config ZMK_KEYBOARD_NAME
    default "e5c pendant"

endif
```

## config/boards/shields/e5c_pendant/Kconfig.shield
```kconfig
# Copyright (c) 2022 The ZMK Contributors
# SPDX-License-Identifier: MIT

config SHIELD_E5C_PENDANT
  def_bool $(shields_list_contains,e5c_pendant)
```
