/*
 * Copyright (c) 2022 The ZMK Contributors
 *
 * SPDX-License-Identifier: MIT
 */

#include <behaviors.dtsi>
#include <dt-bindings/zmk/keys.h>
#include <dt-bindings/zmk/bt.h>
 
/ {
    keymap {
        compatible = "zmk,keymap";
 
        default_layer {
            bindings = <
                &kp LA(R)
                &kp SPACE
                &kp ESC
                &kp LSHIFT
                &kp LCTRL
                &kp LEFT
                &kp RIGHT
                &kp UP
                &kp DOWN
                &kp PG_DN
                &kp PG_UP
                &kp LA(F)
            >;
        };
    };
};
