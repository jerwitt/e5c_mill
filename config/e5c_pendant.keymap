/*
 * Copyright (c) 2022 The ZMK Contributors
 *
 * SPDX-License-Identifier: MIT
 */

#include <behaviors.dtsi>
#include <dt-bindings/zmk/keys.h>
#include <dt-bindings/zmk/bt.h>
#include <dt-bindings/zmk/outputs.h>

#define DEFAULT 0
#define LOWER 1
 
/ {
    keymap {
        compatible = "zmk,keymap";
 
        default_layer {
            bindings = <
                &kp LA(R)
                &kp SPACE
                &kp ESC
                &kp LSHIFT
                &kp LCTRL
                &kp LEFT
                &kp RIGHT
                &kp DOWN
                &kp UP 
                &kp PG_DN
                &kp PG_UP
                &lt LOWER F
            >;
        };
        lower_layer {
            bindings = <
                &kp A
                &kp B
                &kp ESC
                &reset
                &bootloader
                &bt BT_PRV
                &bt BT_NXT
                &bt BT_SEL 0
                &out OUT_TOG
                &out OUT_BLE
                &bt BT_CLR
                &trans
            >;
        };
    };
};
